## mesh_root/main/Kconfig.projbuild
```kconfig
menu "UART Bridge"

config UART_BRIDGE_PORT
    int "UART port number"
    range 0 2
    default 1
    help
      UART port used to forward logs/packets to an external DevKit/host.

config UART_BRIDGE_BAUD
    int "Baud rate"
    default 115200
    help
      UART baud rate.

config UART_BRIDGE_TX_PIN
    int "TX GPIO"
    default 43
    help
      GPIO used for UART TX (from mesh_root to DevKit).

config UART_BRIDGE_RX_PIN
    int "RX GPIO"
    default 44
    help
      GPIO used for UART RX (from DevKit back to mesh_root, if needed).

endmenu
```
